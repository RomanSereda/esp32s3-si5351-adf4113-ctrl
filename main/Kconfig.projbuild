## main/Kconfig.projbuild
```kconfig
menu "USB Dev MSC Configuration"

    choice ESP32_STORAGE_MEDIA
        prompt "Storage Media Used"
        default ESP32_STORAGE_MEDIA_SPIFLASH
        help
            Select the storage media that is exposed to USB host.

        config ESP32_STORAGE_MEDIA_SPIFLASH
            bool "SPI FLASH"

        config ESP32_STORAGE_MEDIA_SDMMCCARD
            bool "SDMMC CARD"
            depends on IDF_TARGET_ESP32S3
    endchoice

    if ESP32_STORAGE_MEDIA_SDMMCCARD

        choice ESP32_SDMMC_BUS_WIDTH
            prompt "SD/MMC bus width"
            default ESP32_SDMMC_BUS_WIDTH_4
            help
                Select the bus width of SD or MMC interface.
                Note that even if 1 line mode is used, D3 pin of the SD card must
                have a pull-up resistor connected. Otherwise the card may enter
                SPI mode, the only way to recover from which is to cycle power to the card.

            config ESP32_SDMMC_BUS_WIDTH_4
                bool "4 lines (D0 - D3)"

            config ESP32_SDMMC_BUS_WIDTH_1
                bool "1 line (D0)"
        endchoice

        if SOC_SDMMC_USE_GPIO_MATRIX

            config ESP32_PIN_CMD
                int "CMD GPIO number"
                default 35 if IDF_TARGET_ESP32S3

            config ESP32_PIN_CLK
                int "CLK GPIO number"
                default 36 if IDF_TARGET_ESP32S3

            config ESP32_PIN_D0
                int "D0 GPIO number"
                default 37 if IDF_TARGET_ESP32S3

            if ESP32_SDMMC_BUS_WIDTH_4

                config ESP32_PIN_D1
                    int "D1 GPIO number"
                    default 38 if IDF_TARGET_ESP32S3

                config ESP32_PIN_D2
                    int "D2 GPIO number"
                    default 33 if IDF_TARGET_ESP32S3

                config ESP32_PIN_D3
                    int "D3 GPIO number"
                    default 34 if IDF_TARGET_ESP32S3

            endif  # ESP32_SDMMC_BUS_WIDTH_4

        endif  # SOC_SDMMC_USE_GPIO_MATRIX

    endif  # ESP32_STORAGE_MEDIA_SDMMCCARD

endmenu
```
